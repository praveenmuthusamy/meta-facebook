## conf/layer.conf
```bitbake
# We have a conf and classes directory, add to BBPATH
BBPATH .= ":${LAYERDIR}"

# We have a recipes-* directories, add to BBFILES
BBFILES += "${LAYERDIR}/recipes-*/*/*.bb \
	${LAYERDIR}/recipes-*/*/*.bbappend"

BBFILE_COLLECTIONS += "facebook"
BBFILE_PATTERN_facebook = "^${LAYERDIR}/"
BBFILE_PRIORITY_facebook = "6"

# Set a variable to get to the top of the meta-layer location
HAB_BASE := '${LAYERDIR}'
```
